## config/west.yml
```yaml
manifest:
  defaults:
    revision: v0.3
  remotes:
  - name: zmkfirmware
    url-base: https://github.com/zmkfirmware
    # Additional modules containing boards/shields/custom code can be listed here as well
    # See https://docs.zephyrproject.org/3.2.0/develop/west/manifest.html#projects
  projects:
  - name: zmk
    remote: zmkfirmware
    import: app/west.yml
  - name: zmk-hillsideD50
    url: https://github.com/mmccoyd/zmk-hillsideD50.git
    revision: v0.2.0
    path: modules/zmk-hillsideD50
  self:
    path: config
```
